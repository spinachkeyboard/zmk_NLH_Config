## boards/shields/nlh_split/Kconfig.defconfig
```kconfig
if SHIELD_NLH_SPLIT_LEFT || SHIELD_NLH_SPLIT_RIGHT

config ZMK_KEYBOARD_NAME
    default "NLH Split"

config ZMK_SPLIT
    default y

if SHIELD_NLH_SPLIT_LEFT

config ZMK_SPLIT_ROLE_CENTRAL
    default y

endif # SHIELD_NLH_SPLIT_LEFT

endif # SHIELD_NLH_SPLIT_LEFT || SHIELD_NLH_SPLIT_RIGHT
```

## boards/shields/nlh_split/Kconfig.shield
```kconfig
config SHIELD_NLH_SPLIT_LEFT
    def_bool $(shields_list_contains,nlh_split_left)

config SHIELD_NLH_SPLIT_RIGHT
    def_bool $(shields_list_contains,nlh_split_right)
```
